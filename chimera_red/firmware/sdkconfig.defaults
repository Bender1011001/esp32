## chimera_red/firmware/sdkconfig.defaults
```kconfig
# Target Configuration
CONFIG_IDF_TARGET="esp32s3"

# WiFi Configuration - CRITICAL for raw TX
CONFIG_ESP_WIFI_STATIC_RX_BUFFER_NUM=16
CONFIG_ESP_WIFI_DYNAMIC_RX_BUFFER_NUM=32
CONFIG_ESP_WIFI_TX_BUFFER_TYPE=0
CONFIG_ESP_WIFI_DYNAMIC_TX_BUFFER_NUM=32
CONFIG_ESP_WIFI_AMPDU_TX_ENABLED=n
CONFIG_ESP_WIFI_AMPDU_RX_ENABLED=n
CONFIG_ESP_WIFI_NVS_ENABLED=y
CONFIG_ESP_WIFI_SOFTAP_BEACON_MAX_LEN=752

# CRITICAL: Enable raw 802.11 TX for management frames (deauth)
CONFIG_ESP_WIFI_ENABLE_WPA3_SAE=n
CONFIG_ESP_WIFI_11KV_SUPPORT=n

# BLE - NimBLE Stack
CONFIG_BT_ENABLED=y
CONFIG_BT_NIMBLE_ENABLED=y
CONFIG_BT_NIMBLE_MAX_CONNECTIONS=3
CONFIG_BT_NIMBLE_ROLE_OBSERVER=y
CONFIG_BT_NIMBLE_ROLE_BROADCASTER=y
CONFIG_BT_NIMBLE_EXT_ADV=y

# Console/UART - USB Serial JTAG for ESP32-S3
CONFIG_ESP_CONSOLE_USB_SERIAL_JTAG=y

# Optimization
CONFIG_COMPILER_OPTIMIZATION_PERF=y
CONFIG_COMPILER_OPTIMIZATION_ASSERTIONS_DISABLE=y

# Stack sizes
CONFIG_ESP_MAIN_TASK_STACK_SIZE=16384
CONFIG_ESP_SYSTEM_EVENT_TASK_STACK_SIZE=8192

# PSRAM Support (if available) - Using safer settings
CONFIG_SPIRAM=y
CONFIG_SPIRAM_MODE_QUAD=y
CONFIG_SPIRAM_SPEED_40M=y
CONFIG_SPIRAM_TRY_ALLOCATE_WIFI_LWIP=y

# Disable watchdog and brownout for debugging (enable in production)
CONFIG_ESP_TASK_WDT=n
CONFIG_ESP_BROWNOUT_DET=n

# Logging
CONFIG_LOG_DEFAULT_LEVEL_INFO=y
CONFIG_LOG_MAXIMUM_LEVEL_DEBUG=y

# Flash Settings
CONFIG_ESPTOOLPY_FLASHSIZE_16MB=y
CONFIG_PARTITION_TABLE_CUSTOM=y
CONFIG_PARTITION_TABLE_CUSTOM_FILENAME="partitions.csv"

# SPI RAM
CONFIG_SPIRAM_ALLOW_STACK_EXTERNAL_MEMORY=y
```
